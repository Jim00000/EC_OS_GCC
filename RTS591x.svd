# RTS591x register map
Vendor: Realtek Semiconductor Corp.; Series: RTS591x Series; File version: 1.0
Real-M300 Arm v8-M Instruction Processor
CPU: ARMV8MML r0p0, little endian, MPU, FPU, VTOR, 3 interrupt priority bits, 4 SAU regions
Registers are 32-bit, read-write, reset 0x0 unless marked. A register's access mark holds for its fields unless they carry their own. Offsets are from the block's base; lines under a group give offsets from that group; [hi:lo] are bit positions; {n}, {i} and the like mark numbered series; 'fields as' and 'values as' point back to an identical list; <NAME> marks a mode.

## Memory map
0x40000000 SHA2 size 0x1000 — Lalu SHA2 Engine
0x40001000 SHA2DMA size 0x1000 — Lalu SHA2 DMA Controller
0x40002000 SHA3 size 0x1000 — Lalu SHA3 Engine
0x40003000 AES size 0x1000 — Lalu AES Engine
0x40004000 AESDMA size 0x1000
0x4000B800 DMA size 0x7FF — DMA Controller
0x4000C000 WDT size 0x28 — WDT Controller
0x4000C014 PWRBTN size 0x2C — Power Button Over WDT Controller
0x4000C100 RTC size 0x24 — RTC Controller
0x4000C200 SLWTMR0 size 0x10 — 32-bit SlowTimer Controller
0x4000C210 SLWTMR1 size 0x10
0x4000C300 TMR0 size 0x14 — 32-bit Timer Controller
0x4000C314 TMR1 size 0x14
0x4000C328 TMR2 size 0x14
0x4000C33C TMR3 size 0x14
0x4000C350 TMR4 size 0x14
0x4000C364 TMR5 size 0x14
0x4000C500 RTMR size 0x10 — RTOS Timer Controller
0x4000D000 I2C0 size 0x200 — I2C Controller
0x4000D200 I2C1 size 0x200
0x4000D400 I2C2 size 0x200
0x4000D600 I2C3 size 0x200
0x4000D800 I2C4 size 0x200
0x4000DA00 I2C5 size 0x200
0x4000DC00 I2C6 size 0x200
0x4000DE00 I2C7 size 0x200
0x4000E000 I3C0 size 0x1000 — I3C Controller
0x4000F000 PWM0 size 0xC — PWM Controller
{0x4000F000+0xC*n} PWM{n} size 0xC (n=1..11)
0x4000F800 PWMLED0 size 0x18 — PWMLED Controller
0x4000F818 PWMLED1 size 0x18
0x4000FD00 TACHO0 size 0x40 — Tachometer Controller
0x4000FD40 TACHO1 size 0x40
0x4000FD80 TACHO2 size 0x40
0x4000FDC0 TACHO3 size 0x40
0x4000FE00 ADC size 0x100 — 12-bit ADC Controller
0x4000FF00 PS2 size 0x100 — PS2 Controller
0x40010000 KBM size 0x100 — Keyboard Matrix Controller
0x40010100 UART size 0x100 — UART Controller
0x40010200 SPIC size 0x1D4 — SPIC Controller
0x40010400 MSPI size 0x100 — SPI Master Controller
0x40010500 SPISLV size 0x100 — SPI Slave Controller
0x40010800 PUF size 0x800 — PUF Controller
0x40020000 SYSTEM size 0x100 — System Controller
0x40020100 OTPDMA size 0xFF — OTP DMA Controller
0x40040000 PKE size 0x40000 — Lalu Public Key Engine
0x40082000 EMI0 size 0x14 — EMI Controller
0x40082020 EMI1 size 0x14
0x40082040 EMI2 size 0x14
0x40082060 EMI3 size 0x14
0x40082080 EMI4 size 0x14
0x400820A0 EMI5 size 0x14
0x400820C0 EMI6 size 0x14
0x400820E0 EMI7 size 0x14
0x40090000 GPIO size 0x210 — GPIO Controller
0x40091000 IOPAD size 0x20 — I/O Pad Controller
0x400A0000 PECI size 0xFF — PECI Controller
0x400A0100 KBC size 0x1C — KBC Controller
0x400A0200 ACPI size 0x1C — ACPI Controller
0x400A021C PMPORT0 size 0x1C — PM Port Controller
0x400A0238 PMPORT1 size 0x1C
0x400A0254 PMPORT2 size 0x1C
0x400A0270 PMPORT3 size 0x1C
0x400A02C0 DIO0 size 0x8 — Dedicated I/O Controller
0x400A02C8 DIO1 size 0x8
0x400A0400 PORT80 size 0x14 — PORT80 Controller
0x400A0414 PORT81 size 0x14
0x400B0000 I3C1 size 0x1000
0x400B1000 ESPI size 0x300 — eSPI Controller
0x400B1400 MONOTONIC size 0x20 — Monotonic Counter
0x400B1600 MBX size 0xD0 — Mailbox Controller

## Interrupts
{n} GPIO{n:03} (GPIO) (n=0..131) — GPIO{n:03} Interrupt
133 ERST (ESPI) — eSPI Reset Pin Interrupt
134 EPRCH (ESPI) — eSPI Peripheral Ch. Interrupt
135 EVCHIDX61 (ESPI) — eSPI Virtual Wire Ch. Index61 Interrupt
136 EVCHIDX51 (ESPI) — eSPI Virtual Wire Ch. Index51 Interrupt
137 EVCHIDX4A (ESPI) — eSPI Virtual Wire Ch. Index4A Interrupt
138 EVCHIDX47 (ESPI) — eSPI Virtual Wire Ch. Index47 Interrupt
139 EVCHIDX44 (ESPI) — eSPI Virtual Wire Ch. Index44 Interrupt
140 EVCHIDX43 (ESPI) — eSPI Virtual Wire Ch. Index43 Interrupt
141 EVCHIDX42 (ESPI) — eSPI Virtual Wire Ch. Index42 Interrupt
142 EVCHIDX41 (ESPI) — eSPI Virtual Wire Ch. Index41 Interrupt
143 EVCHIDX7 (ESPI) — eSPI Virtual Wire Ch. Index7 Interrupt
144 EVCHIDX3 (ESPI) — eSPI Virtual Wire Ch. Index3 Interrupt
145 EVCHIDX2 (ESPI) — eSPI Virtual Wire Ch. Index2 Interrupt
146 EVCH (ESPI) — eSPI Virtual Wire Ch. Interrupt
147 EOCHTX (ESPI) — eSPI OOB Ch. Tx Interrupt
148 EOCHRX (ESPI) — eSPI OOB Ch. Rx Interrupt
149 EOCHCFGEN (ESPI) — eSPI OOB Ch. Conf Enable Change Interrupt
150 EFSAFSTR (ESPI) — eSPI SAFS TR Interrupt
151 EFSAFSERASE (ESPI) — eSPI SAFS Erase Interrupt
152 EFMAFSTR (ESPI) — eSPI MAFS TR Interrupt
153 EFCHCHG (ESPI) — eSPI Flash Chanel Change Interrupt
154 KBC_IB (KBC) — KBC Input Buffer Interrupt
155 KBC_OB (KBC) — KBC Output Buffer Interrupt
156 ACPI_IB (ACPI) — ACPI Input Buffer Interrupt
157 ACPI_OB (ACPI) — ACPI Output Buffer Interrupt
158 PMPORT0_IB (PMPORT0) — PMPORT0 Input Buffer Interrupt
159 PMPORT0_OB (PMPORT0) — PMPORT0 Output Buffer Interrupt
160 PMPORT1_IB (PMPORT1) — PMPORT1 Input Buffer Interrupt
161 PMPORT1_OB (PMPORT1) — PMPORT1 Output Buffer Interrupt
162 PMPORT2_IB (PMPORT2) — PMPORT2 Input Buffer Interrupt
163 PMPORT2_OB (PMPORT2) — PMPORT2 Output Buffer Interrupt
164 PMPORT3_IB (PMPORT3) — PMPORT3 Input Buffer Interrupt
165 PMPORT3_OB (PMPORT3) — PMPORT3 Output Buffer Interrupt
166 PORT80 — PORT80 Interrupt
167 PORT81 — PORT81 Interrupt
168 PECI — PECI Interrupt
169 EFSAFOP2 (ESPI) — eSPI Flash Chanel SAF OP2 Interrupt
180 SPIC — SPIC Interrupt
181 HSPI (SPISLV) — HSPI Interrupt
{n+182} I2C{n} (n=0..7) — I2C{n} Interrupt
190 PS2 — PS2 Interrupt
191 UART — UART Interrupt
192 TACHO0 — TACHO0 Interrupt
193 TACHO1 — TACHO1 Interrupt
194 TACHO2 — TACHO2 Interrupt
195 TACHO3 — TACHO3 Interrupt
196 TMR0 — TIMER0 Interrupt
197 TMR1 — TIMER1 Interrupt
198 TMR2 — TIMER2 Interrupt
199 TMR3 — TIMER3 Interrupt
200 TMR4 — TIMER4 Interrupt
201 TMR5 — TIMER5 Interrupt
202 SLWTMR0 — SLOWTIMER0 Interrupt
203 SLWTMR1 — SLOWTIMER1 Interrupt
204 RTMR — RTOSTIMER Interrupt
205 RTC — RTC Interrupt
206 I3C0 — I3C0 Interrupt
207 I3C1 — I3C1 Interrupt
208 PWRBTN — PWRBTN Interrupt
209 WDT — WDT Interrupt
210 KBM — KBM Interrupt
211 MSPI — MSPI interrupt
{n+212} EMI{n} (n=0..7) — EMI{n} Interrupt
220 MBX — MAILBOX Interrupt
221 ADC — ADC Interrupt
234 DMA — DMA Interrupt
235 SHA2 — SHA2 Interrupt
236 SHA3 — SHA3 Interrupt
237 AES — AES Interrupt
238 PKE — PKE Interrupt
239 PUFOTP (PUF) — PUFOTP Interrupt

## Licence text in the file
The license belong to Realtek Semiconductor Corp. All the rights reserved.
